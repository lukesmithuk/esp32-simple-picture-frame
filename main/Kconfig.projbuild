## main/Kconfig.projbuild
```kconfig
menu "Picture Frame"

    config TEST_MODE
        bool "Enable hardware test mode"
        default n
        help
            When enabled, app_main() runs the hardware integration test suite
            instead of the normal display update cycle.

    config DISABLE_DEEP_SLEEP
        bool "Disable deep sleep (development)"
        default y
        help
            When enabled, the board halts after displaying instead of entering
            deep sleep. Keeps USB-JTAG serial alive for reflashing and debugging.
            Disable for production use.

endmenu
```

## sdkconfig.defaults
```kconfig
# Target
CONFIG_IDF_TARGET="esp32s3"

# PSRAM — octal, 80 MHz, integrated into heap
CONFIG_SPIRAM=y
CONFIG_SPIRAM_MODE_OCT=y
CONFIG_SPIRAM_SPEED_80M=y
CONFIG_SPIRAM_USE_MALLOC=y
CONFIG_SPIRAM_MALLOC_ALWAYSINTERNAL=16384

# Stack / heap
CONFIG_ESP_MAIN_TASK_STACK_SIZE=8192

# Logging — real timestamps after NTP/RTC sync, milliseconds before
CONFIG_LOG_DEFAULT_LEVEL_INFO=y
CONFIG_LOG_TIMESTAMP_SOURCE_SYSTEM=y

# FAT filesystem — long filename support for SD card
CONFIG_FATFS_LFN_HEAP=y
CONFIG_FATFS_MAX_LFN=255

# WiFi — push lwIP buffers to PSRAM to free internal DRAM
CONFIG_ESP_WIFI_ENABLED=y
CONFIG_SPIRAM_TRY_ALLOCATE_WIFI_LWIP=y

# Flash — 16 MB on Waveshare ESP32-S3-PhotoPainter
CONFIG_ESPTOOLPY_FLASHSIZE_16MB=y
CONFIG_ESPTOOLPY_FLASHSIZE="16MB"

# Partition table — single factory app, large (1.5 MB)
CONFIG_PARTITION_TABLE_SINGLE_APP_LARGE=y
```
